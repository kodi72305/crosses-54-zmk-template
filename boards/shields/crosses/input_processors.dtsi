#include <input/processors.dtsi>
#include <zephyr/dt-bindings/input/input-event-codes.h>

/ {
    /omit-if-no-ref/ zip_xy_swap_mapper: zip_xy_swap_mapper {
        compatible = "zmk,input-processor-code-mapper";
        #input-processor-cells = <0>;
        type = <INPUT_EV_REL>;
        map = <INPUT_REL_Y INPUT_REL_X>,
              <INPUT_REL_X INPUT_REL_Y>;
    };

    /omit-if-no-ref/ zip_xy_to_scroll_mapper: zip_xy_to_scroll_mapper {
        compatible = "zmk,input-processor-code-mapper";
        #input-processor-cells = <0>;
        type = <INPUT_EV_REL>;
        map = <INPUT_REL_Y INPUT_REL_WHEEL>,
              <INPUT_REL_X INPUT_REL_HWHEEL>;
    };

    /omit-if-no-ref/ zip_auto_mouse: zip_auto_mouse {
        compatible = "zmk,input-processor-temp-layer";
        #input-processor-cells = <2>;
        require-prior-idle-ms = <800>;
        excluded-positions = <>;
    };
};
